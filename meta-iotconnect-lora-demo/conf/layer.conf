## meta-iotconnect-lora-demo/conf/layer.conf
```bitbake
# We have a conf and classes directory, add to BBPATH
BBPATH .= ":${LAYERDIR}"

# We have recipes-* directories, add to BBFILES
BBFILES += "${LAYERDIR}/recipes-*/*/*.bb \
            ${LAYERDIR}/recipes-*/*/*.bbappend"

BBFILE_COLLECTIONS += "meta-iotconnect-lora-demo"
BBFILE_PATTERN_meta-iotconnect-lora-demo = "^${LAYERDIR}/"
BBFILE_PRIORITY_meta-iotconnect-lora-demo = "6"

LAYERDEPENDS_meta-iotconnect-lora-demo = "core"
LAYERSERIES_COMPAT_meta-iotconnect-lora-demo = "kirkstone"

IMAGE_INSTALL:append = " python3"
IMAGE_INSTALL:append = " screen"
#IMAGE_INSTALL_append = " python3_3.7.9"
```
